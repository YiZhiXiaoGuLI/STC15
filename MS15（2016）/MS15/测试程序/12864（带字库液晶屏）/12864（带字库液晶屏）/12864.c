#include <STC12C5A60S2.H>
#include <intrins.H>
typedef unsigned char uchar;//uchar代替unsigned char
typedef unsigned int  uint;	//uint代替unsigned int

sbit RS = P2^5;//寄存器选择，1为数据寄存器，0为指令寄存器
sbit RW = P2^6;//读写信号，1为读操作，0为写操作
sbit EN = P2^7;//使能，写操作时下降沿有效，读操作时高电平有效
sbit PSB= P2^3;//并串行选择
sbit RST= P2^4;//复位

uchar code dis1[]={"    红欧电子    "};
uchar code dis2[]={"祝您网上购物愉快"};
uchar code dis3[]={"hiold.taobao.com"};
uchar code dis4[]={"  旺旺ID：hiold "};



/************************************************************************************************************
*************************************延时函数****************************************************************
************************************************************************************************************/

void Delayms(uchar ms)		//@11.0592MHz
{
	uchar i, j;

	while(ms--)
		{
			i = 11;
			j = 190;
			do
				{
					while (--j);
				}
			 while (--i);
		}
}

void Delayus(uchar us)		//@11.0592MHz
{
	uchar i;

	while(us--)
		{
			_nop_();
			_nop_();
			i = 24;
			while (--i);
		}
}

/************************************************************************************************************
*************************************读忙函数****************************************************************
************************************************************************************************************/

bit busy()
{
	bit mang;
	RS=0;
	RW=1;
	EN=1;
	Delayus(2);
	mang=(bit)(P0&0x80);//读取P0最高位的值
	EN=0;
	return mang;//返回读到的忙状态
}

/************************************************************************************************************
*************************************写指令函数**************************************************************
************************************************************************************************************/

void WCMD(uchar cmd)
{
	while(busy());//查忙
	RS=0;
	RW=0;
	EN=0;
	P0=cmd;//将指令赋给P0
    Delayus(1);//摸拟产生一个脉冲
	EN=1;
    Delayus(1);
	EN=0;
}

/************************************************************************************************************
*************************************写数据函数**************************************************************
************************************************************************************************************/

void WDAT(uchar dat)
{
	while(busy());//查忙
	RS=1;
	RW=0;
	EN=0;
	P0=dat;//将数据赋给P0
	Delayus(1);//摸拟产生一个脉冲
	EN=1;
	Delayus(1);
	EN=0;
}

/************************************************************************************************************
*************************************初始化函数**************************************************************
************************************************************************************************************/

void init()
{
	PSB=1;//并行方式
	RST=0;//复位
	Delayms(1);
	RST=1;
	WCMD(0X34);//扩充指令操作
	Delayms(1);
	WCMD(0X30);//基本指令操作
 	Delayms(1);
	WCMD(0x0C);//开显示，关光标
	Delayms(1);
	WCMD(0X01);//清屏
	Delayms(10);
}

/************************************************************************************************************
*************************************主函数*****************************************************************
************************************************************************************************************/

void main()
{
	uchar i;
	init();
    WCMD(0X80);	//设置第一行地址
	for(i=0;i<16;i++)//显示第一行内容
		{
			WDAT(dis1[i]);
		    Delayms(10);
		}
	WCMD(0X90);//设置第二行地址
	for(i=0;i<16;i++)//显示第二行内容
		{
			WDAT(dis2[i]);
			Delayms(10);
		}
	WCMD(0X88);//设置第三行地址
	for(i=0;i<16;i++)//显示第三行内容
		{
			WDAT(dis3[i]);
			Delayms(10);
		}
	WCMD(0X98);//设置第四行地址
	for(i=0;i<16;i++)//显示第4行内容
		{
			WDAT(dis4[i]);
			Delayms(10);
		}

	while(1);
}





