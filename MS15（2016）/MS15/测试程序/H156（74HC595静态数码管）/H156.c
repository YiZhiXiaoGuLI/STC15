/********************************************/
//H156数码管模块测试程序
//循环显示0-F,级联数量无限制，用于显示功能测试
//hiold.taobao.com
/********************************************/

#include <STC12C5A60S2.H>

/*******************************************/

sbit DS = P1^0;	//串行数据
sbit ST = P1^1;	//存储寄存器时钟
sbit SH = P1^2;	//移位寄存器时钟

/////////////////////////////////////////////

/*******************************************/

unsigned char code LED16[] = 
{// 0	 1	  2	   3	4	 5	  6	   7	8	 9	  A	   b	C    d	  E    F    
	0x40,0x79,0x24,0x30,0x19,0x12,0x02,0x78,0x00,0x10,0x08,0x03,0x46,0x21,0x06,0x0e
};

////////////////////////////////////////////

/*******************************************/
//延时
/*******************************************/

void Delay()		//@11.0592MHz
{
	unsigned char i, j, k;

	i = 12;
	j = 129;
	k = 119;
	do
	{
		do
		{
			while (--k);
		} while (--j);
	} while (--i);
}

/////////////////////////////////////////////

/*******************************************/
//发送数据
/*******************************************/
void Display(unsigned char n)
{
	unsigned char i;
	for(i=0;i<8;i++) //发送8位数据
	{
		if(n&0x80)DS=1;
		else DS=0;    //判断当前发送位数据
		n <<= 1;      //左移一位
		SH = 0;
		SH = 1;       //移位寄存器操作
	}
}

/////////////////////////////////////////////

/*******************************************/
//主程序
/*******************************************/

void main()
{
	unsigned char LED,m;
	unsigned char code *LED_table;  //查表指针
	while(1)
	{
		if(LED>=16)	//循环显示0-F
		{
			LED=0;
		}
		LED_table = LED16 + LED;
		m = *LED_table;
		Display(m);	//送显示
		ST = 0;
		ST = 1;		//存储寄存器操作
		LED++;
		Delay();
	}

}

/////////////////////////////////////////////


